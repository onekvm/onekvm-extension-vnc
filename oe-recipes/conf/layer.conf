## oe-recipes/conf/layer.conf
```bitbake
BBPATH .= ":${LAYERDIR}"

BBFILES += "${LAYERDIR}/recipes-*/*/*.bb \
            ${LAYERDIR}/recipes-*/*/*.bbappend"

BBFILE_COLLECTIONS += "onekvm-extension-vnc"
BBFILE_PATTERN_onekvm-extension-vnc := "^${LAYERDIR}/"
BBFILE_PRIORITY_onekvm-extension-vnc = "8"

LAYERDEPENDS_onekvm-extension-vnc = "core onekvm"
LAYERSERIES_COMPAT_onekvm-extension-vnc = "wrynose"
```
